/*
* Copyright (c) 2020 The ZMK Contributors
*
* SPDX-License-Identifier: MIT
*/

/ {
/omit-if-no-ref/ intl: input_processor_auto_layer {
  compatible = "zmk,input-processor-auto-layer";
  #input-processor-cells = <1>;
};
};
