/*
 * Copyright (c) 2020 The ZMK Contributors
 *
 * SPDX-License-Identifier: MIT
 */

/ {
    behaviors {
        /omit-if-no-ref/ intl: input_behavior_auto_layer {
            compatible = "zmk,input-behavior-auto-layer";
            #binding-cells = <1>;
            require-prior-idle-ms = <-1>;
        };
    };
};
