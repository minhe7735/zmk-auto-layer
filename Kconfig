## Kconfig
```kconfig
# Sensor data simulator
#
# Copyright (c) 2019 Nordic Semiconductor
#
# SPDX-License-Identifier: LicenseRef-Nordic-5-Clause
#
if ZMK_MOUSE
if !ZMK_SPLIT || ZMK_SPLIT_ROLE_CENTRAL

config ZMK_INPUT_PROCESSOR_AUTO_LAYER
    bool "Temporary Layer Input Processor"
    default y
    depends on DT_HAS_ZMK_INPUT_PROCESSOR_AUTO_LAYER_ENABLED

endif # !ZMK_SPLIT || ZMK_SPLIT_ROLE_CENTRAL
endif
```

## dts/bindings/input_processors/zmk,input-processor-auto-layer.yaml
```yaml
# Copyright (c) 2020 The ZMK Contributors
# SPDX-License-Identifier: MIT

description: Input Behavior To Toggle Layer

compatible: "zmk,input-processor-auto-layer"

include: ip_one_param.yaml

properties:
    require-prior-idle-ms:
        type: int
        required: false
        default: -1
        description: Time in milliseconds that must pass after the last keystroke before the layer can be toggled

    excluded-positions:
        type: array
        required: false
        default: []
        description: Array of key positions that will NOT trigger layer deactivation when pressed
```

## dts/bindings/zmk,input-behavior-auto-layer.yaml
```yaml
# Copyright (c) 2020 The ZMK Contributors
# SPDX-License-Identifier: MIT

description: Input Behavior To Toggle Layer

compatible: "zmk,input-behavior-auto-layer"

include: one_param.yaml

properties:
    require-prior-idle-ms:
        type: int
        required: false
        default: -1
        description: Time in milliseconds that must pass after the last keystroke before the layer can be toggled

    excluded-positions:
        type: array
        required: false
        default: []
        description: Array of key positions that will NOT trigger layer deactivation when pressed
```
